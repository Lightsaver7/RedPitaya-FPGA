/dts-v1/;
/plugin/;

&gpio0 {
    led-system {
        compatible = "gpio-leds";

        led-8-yellow {
            default-state = "off";
            gpios = <&gpio0 0 0>;
            label = "led8";
            linux,default-trigger = "mmc0";
        };
    };
};
